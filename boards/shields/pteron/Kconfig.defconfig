## boards/shields/pteron/Kconfig.defconfig
```kconfig
# Copyright (c) 2021 The ZMK Contributors
# SPDX-License-Identifier: MIT

if SHIELD_PTERON

config ZMK_KEYBOARD_NAME
    default "Pteron Keyboard"

endif
```

## boards/shields/pteron/Kconfig.shield
```kconfig
# Copyright (c) 2021 The ZMK Contributors
# SPDX-License-Identifier: MIT

config SHIELD_PTERON
    def_bool $(shields_list_contains,pteron)
```
